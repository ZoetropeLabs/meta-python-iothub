## conf/layer.conf
```bitbake
BBPATH := "${BBPATH}:${LAYERDIR}"

BBFILES += "${LAYERDIR}/recipes-*/*/*.bb \
            ${LAYERDIR}/recipes-*/*/*.bbappend"

BBFILE_COLLECTIONS += "iothub"
BBFILE_PATTERN_iothub = "^${LAYERDIR}/"

LAYERVERSION_iothub = "1" 
```
